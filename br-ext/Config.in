## br-ext/Config.in
```kconfig
source "$BR2_EXTERNAL_OPTEE_PATH/package/optee_os_ext/Config.in"
source "$BR2_EXTERNAL_OPTEE_PATH/package/optee_client_ext/Config.in"
source "$BR2_EXTERNAL_OPTEE_PATH/package/optee_test_ext/Config.in"
source "$BR2_EXTERNAL_OPTEE_PATH/package/optee_examples_ext/Config.in"
source "$BR2_EXTERNAL_OPTEE_PATH/package/optee_rust_examples_ext/Config.in"
source "$BR2_EXTERNAL_OPTEE_PATH/package/ftpm_optee_ext/Config.in"
source "$BR2_EXTERNAL_OPTEE_PATH/package/linux_ftpm_mod_ext/Config.in"
source "$BR2_EXTERNAL_OPTEE_PATH/package/xen_ext/Config.in"
```

## br-ext/package/docopt.cpp_ext/Config.in
```kconfig
config BR2_PACKAGE_DOCOPT_CPP_EXT
	bool "docopt.cpp_ext"
	depends on BR2_INSTALL_LIBSTDCPP
	depends on BR2_TOOLCHAIN_GCC_AT_LEAST_4_7 # C++11
	help
	  docopt is a library that lets you define a command line
	  interface with the utility argument syntax that has been
	  used by command line utilities for decades (POSIX.1-2017).
	  From the description, docopt automatically generates a parser
	  for the command line arguments.

	  docopt Command-line interface description language
	  http://docopt.org/

	  docopt C++ port https://github.com/docopt/docopt.cpp
```

## br-ext/package/ftpm_optee_ext/Config.in
```kconfig
config BR2_PACKAGE_FTPM_OPTEE_EXT
       bool "Enable fTPM based on OPTEE"
       select BR2_PACKAGE_OPTEE_OS_EXT
       help
         fTPM, http://github.com/microsoft/ms-tpm-20-ref.
	 NOTE: This package currently only takes care of installing files
	 into the root FS, that have been compiled already.
	 The build of the OPTEE fTPM service is assumed to have been done
	 previously.

config BR2_PACKAGE_FTPM_OPTEE_EXT_SITE
	string "FTPM_OPTEE installation package path"
	default ""
	help
	  The path to this installation package.

config BR2_PACKAGE_FTPM_OPTEE_PACKAGE_SITE
	string "Path to the TPM 2.0 Reference Implementation"
	default ""
	help
	  The path to this installation package.

config BR2_PACKAGE_FTPM_OPTEE_EXT_TA_SRC
       string "Path of the fTPM sources within the TPM Ref. Implementation"
       default "Samples/ARM32-FirmwareTPM/optee_ta"
       help
         The path, relative to where the TPM 2.0 Reference Implementation
	 is installed, where the sources for the fTPM can be found.
```

## br-ext/package/linux_ftpm_mod_ext/Config.in
```kconfig
config BR2_PACKAGE_LINUX_FTPM_MOD_EXT
       bool "Enable TPM Kernel module"
       help
         Enable TPM Kernel module.
	 NOTE: This package currently only takes care of installing files
	 into the root FS, that have been compiled already.
	 The build of the TPM Kernel module is assumed to have been done
	 previously.

config BR2_PACKAGE_LINUX_FTPM_MOD_EXT_SITE
	string "TPM Kernel Module installation package path"
	default ""
	help
	  The path to this installation package.

config BR2_PACKAGE_LINUX_FTPM_MOD_EXT_PATH
	string "Path to the TPM Kernel module"
	default ""
	help
	  The path of the TPM Kernel sources.
```

## br-ext/package/opensc/Config.in
```kconfig
config BR2_PACKAGE_OPENSC
	bool "opensc"
	select BR2_PACKAGE_PCSC_LITE
	help
	    Installs opensc
```

## br-ext/package/optee_benchmark/Config.in
```kconfig
config BR2_PACKAGE_OPTEE_BENCHMARK
	bool "optee_benchmark"
	select BR2_PACKAGE_LIBYAML
	help
	  http://github.org/OP-TEE/optee_benchmark

config BR2_PACKAGE_OPTEE_BENCHMARK_SITE
	string "OP-TEE benchmark path"
	default ""
	help
	  The path to the source directory of OP-TEE benchmark
```

## br-ext/package/optee_client/Config.in
```kconfig
config BR2_PACKAGE_OPTEE_CLIENT_EXT
	bool "optee_client"
	help
	  http://github.org/OP-TEE/optee_client

config BR2_PACKAGE_OPTEE_CLIENT_EXT_SITE
	string "OP-TEE client path"
	default ""
	help
	  The path to the source directory of OP-TEE client
```

## br-ext/package/optee_client_ext/Config.in
```kconfig
config BR2_PACKAGE_OPTEE_CLIENT_EXT
	bool "optee_client"
	select BR2_PACKAGE_UTIL_LINUX
	select BR2_PACKAGE_UTIL_LINUX_LIBS
	select BR2_PACKAGE_UTIL_LINUX_LIBUUID
	help
	  http://github.org/OP-TEE/optee_client

config BR2_PACKAGE_OPTEE_CLIENT_EXT_SITE
	string "OP-TEE client path"
	default ""
	help
	  The path to the source directory of OP-TEE client

config BR2_PACKAGE_OPTEE_CLIENT_EXT_RPMB_EMU
	bool "Enable RPMB emulation"
	default y
	help
	  Enable RPMB device emulation in tee-supplicant.
```

## br-ext/package/optee_examples/Config.in
```kconfig
config BR2_PACKAGE_OPTEE_EXAMPLES
	bool "optee_examples"
	help
	  http://github.org/OP-TEE/optee_examples

if BR2_PACKAGE_OPTEE_EXAMPLES

config BR2_PACKAGE_OPTEE_EXAMPLES_SITE
	string "OP-TEE examples path"
	default ""
	help
	  The path to the source directory of OP-TEE examples

config BR2_PACKAGE_OPTEE_EXAMPLES_SDK
	string "OPTEE SDK path"
	default ""
	help
	  some help

config BR2_PACKAGE_OPTEE_EXAMPLES_CROSS_COMPILE
	string "OPTEE cross compiler"
	default ""
	help
	  some help

endif
```

## br-ext/package/optee_examples_ext/Config.in
```kconfig
config BR2_PACKAGE_OPTEE_EXAMPLES_EXT
	bool "optee_examples"
	help
	  http://github.org/OP-TEE/optee_examples

config BR2_PACKAGE_OPTEE_EXAMPLES_EXT_SITE
	string "OP-TEE examples path"
	default ""
	help
	  The path to the source directory of OP-TEE examples

if BR2_PACKAGE_OPTEE_EXAMPLES_EXT

config BR2_PACKAGE_OPTEE_EXAMPLES_EXT_SDK
	string "OPTEE SDK path"
	default ""
	help
	  some help

config BR2_PACKAGE_OPTEE_EXAMPLES_EXT_CROSS_COMPILE
	string "OPTEE cross compiler"
	default ""
	help
	  some help

endif
```

## br-ext/package/optee_os/Config.in
```kconfig
config BR2_PACKAGE_OPTEE_OS
	bool "optee_os"
	select BR2_PACKAGE_OPENSSL
	help
	  http://github.org/OP-TEE/optee_os

if BR2_PACKAGE_OPTEE_OS

config BR2_PACKAGE_OPTEE_OS_PLATFORM
	string "PLATFORM"
	help
	  Value for the PLATFORM directive provided to OP-TEE OS.

config BR2_PACKAGE_OPTEE_OS_PLATFORM_FLAVOR
	string "PLATFORM_FLAVOR"
	help
	  Value for the optional PLATFORM_FLAVOR directive provided to
	  OP-TEE OS.


config BR2_PACKAGE_OPTEE_OS_BUILD
	bool "Build optee_os core and devkit from scratch"
	default false
	help
	  If enabled, the OP-TEE OS core and trusted libraries.

config BR2_PACKAGE_OPTEE_OS_SERVICES
	bool "services from optee_os"
	default false
	help
	  Build and embed the generic services trusted applications from
	  optee_os.

config BR2_PACKAGE_OPTEE_OS_SDK
	string "OPTEE SDK path"
	help
	  If set, use the TA devkit path provided in configuration directive.

config BR2_PACKAGE_OPTEE_OS_ADDITIONAL_VARIABLES
	string "addition configuration directives
	help
	  Any additional configuration directives provided to OP-TEE OS, e.g
	  "CFG_TEE_CODE_DEBUG=y CFG_TEE_CORE_LOG_LEVEL=3"
endif
```

## br-ext/package/optee_os_ext/Config.in
```kconfig
config BR2_PACKAGE_OPTEE_OS_EXT
	bool "optee_os"
	help
	  OP-TEE OS, http://github.org/OP-TEE/optee_os.
	  NOTE: this package currently only takes care of installing files into
	  the root FS, that have been compiled already. For example, shared
	  libraries used by TAs when CFG_ULIBS_SHARED=y.
	  The build of optee_os itself is assumed to have been done previously.

config BR2_PACKAGE_OPTEE_OS_EXT_SITE
	string "OP-TEE OS installation package path"
	default ""
	help
	  The path to this installation package.

if BR2_PACKAGE_OPTEE_OS_EXT

config BR2_PACKAGE_OPTEE_OS_EXT_SDK
	string "OPTEE SDK path"
	default ""
	help
	  The path to export-ta_arm32 or export-ta_arm64 in the optee_os output
	  directory.

endif
```

## br-ext/package/optee_os_services/Config.in
```kconfig
config BR2_PACKAGE_OPTEE_OS_SERVICES
	bool "optee_os as package to build service TAs installed in fs"
	help
	  Build and install services TAs from the optee_os package

if BR2_PACKAGE_OPTEE_OS_SERVICES

config BR2_PACKAGE_OPTEE_OS_SERVICES_SITE
	string "OP-TEE OS path"
	default ""
	help
	  The path to the source directory of OP-TEE test

config BR2_PACKAGE_OPTEE_OS_SERVICES_SDK
	string "OP-TEE SDK path"
	help
	  TA devkit to use for building service TAs from optee_os.

config BR2_PACKAGE_OPTEE_OS_SERVICES_CROSS_COMPILE
	string "OP-TEE cross compiler"
	default ""
	help
	  some help

endif # BR2_PACKAGE_OPTEE_OS_SERVICES
```

## br-ext/package/optee_rust_examples_ext/Config.in
```kconfig
config BR2_PACKAGE_OPTEE_RUST_EXAMPLES_EXT
	bool "optee_rust_examples"
	help
	  https://github.com/apache/incubator-teaclave-trustzone-sdk

config BR2_PACKAGE_OPTEE_RUST_EXAMPLES_EXT_SITE
	string "OP-TEE Rust examples path"
	default ""
	help
	  The path to the source directory of OP-TEE Rust SDK

if BR2_PACKAGE_OPTEE_RUST_EXAMPLES_EXT

config BR2_PACKAGE_OPTEE_RUST_EXAMPLES_EXT_SDK
	string "OPTEE SDK path"
	default ""
	help
	  The path to OP-TEE TA development SDK

config BR2_PACKAGE_OPTEE_RUST_EXAMPLES_EXT_TARGET_HOST
	string "OP-TEE Rust examples host Rust target"
	default "aarch64-unknown-linux-gnu"
	help
	  The Rust target platform for building the client part of the Rust
	  examples. For details regarding supported Rust target platforms,
	  have a look here:
	  https://doc.rust-lang.org/stable/rustc/platform-support.html

config BR2_PACKAGE_OPTEE_RUST_EXAMPLES_EXT_TARGET_TA
	string "OP-TEE Rust examples TA Rust target"
	default "aarch64-unknown-linux-gnu"
	help
	  The Rust target platform for building the TA part of the Rust
	  examples. For details regarding supported Rust target platforms,
	  have a look here:
	  https://doc.rust-lang.org/stable/rustc/platform-support.html

config BR2_PACKAGE_OPTEE_RUST_EXAMPLES_EXT_CROSS_COMPILE_HOST
	string "OP-TEE Rust examples host cross compiler"
	default "aarch64-linux-gnu-"
	help
	  Rust native compiler doesn't come with its own linker for most of
	  the target platforms. Hence this options provides path to GCC linker
	  in order to link client part of the Rust examples. For example:
	  aarch64-linux-gnu- or path/to/aarch64-linux-gnu-

config BR2_PACKAGE_OPTEE_RUST_EXAMPLES_EXT_CROSS_COMPILE_TA
	string "OP-TEE Rust examples TA cross compiler"
	default "aarch64-linux-gnu-"
	help
	  Rust native compiler doesn't come with its own linker for most of
	  the target platforms. Hence this options provides path to GCC linker
	  in order to link TA part of the Rust examples. For example:
	  aarch64-linux-gnu- or path/to/aarch64-linux-gnu-

config BR2_PACKAGE_OPTEE_RUST_EXAMPLES_EXT_TC_PATH
	string "OP-TEE Rust toolchain installation path"
	default ""
	help
	  The path to OP-TEE Rust toolchain installation directory
endif
```

## br-ext/package/optee_test/Config.in
```kconfig
config BR2_PACKAGE_OPTEE_TEST
	bool "optee_test"
	select BR2_PACKAGE_OPTEE_CLIENT
	help
	  http://github.org/OP-TEE/optee_test

if BR2_PACKAGE_OPTEE_TEST

config BR2_PACKAGE_OPTEE_TEST_SITE
	string "OP-TEE test path"
	default ""
	help
	  The path to the source directory of OP-TEE test

config BR2_PACKAGE_OPTEE_TEST_SDK
	string "OPTEE SDK path"
	default ""
	help
	  some help

config BR2_PACKAGE_OPTEE_TEST_CROSS_COMPILE
	string "OPTEE cross compiler"
	default ""
	help
	  some help

endif
```

## br-ext/package/optee_test_ext/Config.in
```kconfig
config BR2_PACKAGE_OPTEE_TEST_EXT
	bool "optee_test"
	select BR2_PACKAGE_OPTEE_CLIENT_EXT
	help
	  http://github.org/OP-TEE/optee_test

config BR2_PACKAGE_OPTEE_TEST_EXT_SITE
	string "OP-TEE test path"
	default ""
	help
	  The path to the source directory of OP-TEE test

if BR2_PACKAGE_OPTEE_TEST_EXT

config BR2_PACKAGE_OPTEE_TEST_EXT_SDK
	string "OPTEE SDK path"
	default ""
	help
	  some help

config BR2_PACKAGE_OPTEE_TEST_EXT_CROSS_COMPILE
	string "OPTEE cross compiler"
	default ""
	help
	  some help

config BR2_PACKAGE_OPTEE_TEST_EXT_GP_PACKAGE
	string "GP package"
	default ""
	help
	  Path to the GlobalPlatform package containing description files
	  and TAs needed to build the complete GP test suite. The package
	  is free for GP members, but can be acquired directly from
	  GlobalPlatform for non-members. See
	  https://globalplatform.org/test-suites/tee-initial-configuration-test-suite-with-excluded-tests-list/
	  The name of the package is currently "TEE Initial Configuration
	  Test Suite with Excluded Tests List v2.0.0.2" with the file name
	  TEE_Initial_Configuration-Test_Suite_v2_0_0_2-2017_06_09.7z

config BR2_PACKAGE_OPTEE_TEST_EXT_WITH_TLS_TESTS
	bool "with-tls-tests"
	help
	  Select Thread Local Storage tests in Trusted Applications. Some
	  toolchains may not support this.

config BR2_PACKAGE_OPTEE_TEST_EXT_WITH_CXX_TESTS
	bool "with-cxx-tests"
	help
	  Select C++ tests in Trusted Applications. Some toolchains may not
	  support this.

endif
```

## br-ext/package/veraison_rust_apiclient_ext/Config.in
```kconfig
config BR2_PACKAGE_VERAISON_RUST_APICLIENT_EXT
    bool "veraison_rust_apiclient_ext"
    depends on BR2_PACKAGE_HOST_RUSTC_TARGET_ARCH_SUPPORTS
    select BR2_PACKAGE_HOST_RUSTC
    select BR2_PACKAGE_OPENSSL
    help
      This package builds Veraison API client.

      https://github.com/veraison/apiclient
```

## br-ext/package/xen_ext/Config.in
```kconfig
config BR2_PACKAGE_XEN_EXT
	bool "xen_ext"
	# needs "dmb" on ARM, so ARM >= v7
	depends on BR2_ARM_CPU_ARMV7A || BR2_aarch64
	select BR2_PACKAGE_XEN_EXT_HYPERVISOR if !BR2_PACKAGE_XEN_EXT_TOOLS
	help
	  This package builds the Xen hypervisor and toolstack.

	  http://www.xenproject.org/

if BR2_PACKAGE_XEN_EXT

config BR2_PACKAGE_XEN_EXT_SITE
	string "Xen source path"
	default ""
	help
	  The path to the source directory of Xen

config BR2_PACKAGE_XEN_EXT_HYPERVISOR
	bool "Xen hypervisor"
	help
	  The Xen binaries are avaliable in /usr/lib/xen/ See
	  http://wiki.xenproject.org/wiki/Getting_Started for using
	  the Xen hypervisor.

config BR2_PACKAGE_XEN_EXT_TOOLS
	bool "Xen tools"
	depends on !BR2_STATIC_LIBS # dtc (libfdt)
	depends on BR2_TOOLCHAIN_HAS_THREADS # libglib2
	depends on BR2_USE_WCHAR # libglib2
	select BR2_PACKAGE_DTC
	select BR2_PACKAGE_LIBAIO
	select BR2_PACKAGE_LIBGLIB2
	select BR2_PACKAGE_NCURSES
	select BR2_PACKAGE_OPENSSL
	select BR2_PACKAGE_PIXMAN
	select BR2_PACKAGE_SLIRP
	select BR2_PACKAGE_UTIL_LINUX
	select BR2_PACKAGE_UTIL_LINUX_LIBUUID
	select BR2_PACKAGE_YAJL
	select BR2_PACKAGE_ARGP_STANDALONE if !BR2_TOOLCHAIN_USES_GLIBC
	select BR2_PACKAGE_UTIL_LINUX_BINARIES
	select BR2_PACKAGE_QEMU
	help
	  The Xen tools can be accessed by the xl command.

comment "xen tools need a toolchain w/ wchar, threads, dynamic library"
	depends on !BR2_USE_WCHAR || !BR2_TOOLCHAIN_HAS_THREADS || \
		BR2_STATIC_LIBS

endif
```

## dra7xx/fitImage.its
```
/dts-v1/;

/ {
	description = "U-Boot fitImage";
	#address-cells = <1>;

	images {
		kernel@1 {
			description = "Linux kernel";
			data = /incbin/("zImage.sec");
			type = "kernel";
			arch = "arm";
			os = "linux";
			compression = "none";
			load = <0x82000000>;
			entry = <0x82000000>;
		};

		dra7-evm.dtb {
			description = "Flattened Device Tree blob";
			data = /incbin/("dra7-evm.dtb.sec");
			type = "flat_dt";
			arch = "arm";
			compression = "none";
		};

		dra72-evm-revc.dtb {
			description = "Flattened Device Tree blob";
			data = /incbin/("dra72-evm-revc.dtb.sec");
			type = "flat_dt";
			arch = "arm";
			compression = "none";
		};

		dra71-evm.dtb {
			description = "Flattened Device Tree blob";
			data = /incbin/("dra71-evm.dtb.sec");
			type = "flat_dt";
			arch = "arm";
			compression = "none";
		};

		optee {
			description = "OPTEE OS Image";
			data = /incbin/("tee.bin.sec");
			type = "tee";
			arch = "arm";
			compression = "none";
		};
	};

	configurations {
		default = "dra7-evm.dtb";

		dra7-evm.dtb {
			description = "Linux kernel, FDT blob, OPTEE OS";
			kernel = "kernel@1";
			fdt = "dra7-evm.dtb";
			loadables = "optee";
		};

		dra72-evm-revc.dtb {
			description = "Linux kernel, FDT blob, OPTEE OS";
			kernel = "kernel@1";
			fdt = "dra72-evm-revc.dtb";
			loadables = "optee";
		};

		dra71-evm.dtb {
			description = "Linux kernel, FDT blob, OPTEE OS";
			kernel = "kernel@1";
			fdt = "dra71-evm.dtb";
			loadables = "optee";
		};
	};
};
```
