// SPDX-License-Identifier: BSD-3-Clause
/*
 * Copyright (c) 2023, Arm Limited. All rights reserved.
 */

/ {
	reserved-memory {
		mm_communicate_carveout@42000000 {
			reg = <0x00000000 0x42000000 0 0x00008000>;
		};
	};
};
