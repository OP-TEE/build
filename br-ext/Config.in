## ti/fitImage-am43xx.its
```
/dts-v1/;

/ {
	description = "U-Boot fitImage";
	#address-cells = <1>;

	images {
		kernel@1 {
			description = "Linux kernel";
			data = /incbin/("zImage.sec");
			type = "kernel";
			arch = "arm";
			os = "linux";
			compression = "none";
			load = <0x82000000>;
			entry = <0x82000000>;
		};

		am437x-gp-evm.dtb {
			description = "Flattened Device Tree blob";
			data = /incbin/("am437x-gp-evm.dtb.sec");
			type = "flat_dt";
			arch = "arm";
			compression = "none";
		};

		am43x-epos-evm.dtb {
			description = "Flattened Device Tree blob";
			data = /incbin/("am43x-epos-evm.dtb.sec");
			type = "flat_dt";
			arch = "arm";
			compression = "none";
		};

		optee {
			description = "OPTEE OS Image";
			data = /incbin/("tee.bin.sec");
			type = "tee";
			arch = "arm";
			compression = "none";
			load = <0xbdb000e4>;
		};
	};

	configurations {
		default = "am437x-gp-evm.dtb";

		am437x-gp-evm.dtb {
			description = "Linux kernel, FDT blob, OPTEE OS";
			kernel = "kernel@1";
			fdt = "am437x-gp-evm.dtb";
			loadables = "optee";
		};

		am43x-epos-evm.dtb {
			description = "Linux kernel, FDT blob, OPTEE OS";
			kernel = "kernel@1";
			fdt = "am43x-epos-evm.dtb";
			loadables = "optee";
		};
	};
};
```

## ti/fitImage-am57xx.its
```
/dts-v1/;

/ {
	description = "U-Boot fitImage";
	#address-cells = <1>;

	images {
		kernel@1 {
			description = "Linux kernel";
			data = /incbin/("zImage.sec");
			type = "kernel";
			arch = "arm";
			os = "linux";
			compression = "none";
			load = <0x82000000>;
			entry = <0x82000000>;
		};

		am57xx-evm.dtb {
			description = "Flattened Device Tree blob";
			data = /incbin/("am57xx-evm.dtb.sec");
			type = "flat_dt";
			arch = "arm";
			compression = "none";
		};

		am57xx-evm-reva3.dtb {
			description = "Flattened Device Tree blob";
			data = /incbin/("am57xx-evm-reva3.dtb.sec");
			type = "flat_dt";
			arch = "arm";
			compression = "none";
		};

		optee {
			description = "OPTEE OS Image";
			data = /incbin/("tee.bin.sec");
			type = "tee";
			arch = "arm";
			compression = "none";
		};
	};

	configurations {
		default = "am57xx-evm-reva3.dtb";

		am57xx-evm.dtb {
			description = "Linux kernel, FDT blob, OPTEE OS";
			kernel = "kernel@1";
			fdt = "am57xx-evm.dtb";
			loadables = "optee";
		};

		am57xx-evm-reva3.dtb {
			description = "Linux kernel, FDT blob, OPTEE OS";
			kernel = "kernel@1";
			fdt = "am57xx-evm-reva3.dtb";
			loadables = "optee";
		};
	};
};
```

## versal/fitImage-versal-net-vnx-b2197-revA.its
```
/dts-v1/;

/ {
    description = "U-Boot fitImage for plnx_aarch64 kernel";
    #address-cells = <1>;

    images {
        ramdisk {
            description = "ramdisk";
            data = /incbin/("../../out-br/images/rootfs.cpio.gz");
            type = "ramdisk";
            arch = "arm64";
            os = "linux";
            compression = "gzip";
            hash1 {
                algo = "sha1";
            };
        };
    };
    configurations {
        default = "conf1";
        conf1 {
            description = "Ramdisk";
	    ramdisk = "ramdisk";
            hash1 {
                algo = "sha1";
            };
        };
    };
};
```

## versal/fitImage-versal-vck190.its
```
/dts-v1/;

/ {
    description = "U-Boot fitImage for plnx_aarch64 kernel";
    #address-cells = <1>;

    images {
        kernel {
            description = "Linux Kernel";
            data = /incbin/("./../../linux/arch/arm64/boot/Image");
            type = "kernel";
            arch = "arm64";
            os = "linux";
            compression = "none";
            load = <0x80000>;
            entry = <0x80000>;
            hash1 {
                algo = "sha1";
            };
        };
        fdt-1 {
            description = "Flattened Device Tree blob";
            data = /incbin/("../../u-boot/arch/arm/dts/versal-vck190-revA-x-ebm-01-revA.dtb");
            type = "flat_dt";
            arch = "arm64";
            load = <0x10000000>;
            compression = "none";
            hash1 {
                algo = "sha1";
            };
        };
        fdt-2 {
            description = "Flattened Device Tree overlay";
            data = /incbin/("versal-optee.dtbo");
            type = "flat_dt";
            arch = "arm64";
            load = <0x11000000>;
            compression = "none";
            hash1 {
                algo = "sha1";
            };
        };
        ramdisk {
            description = "ramdisk";
            data = /incbin/("../../out-br/images/rootfs.cpio.gz");
            type = "ramdisk";
            arch = "arm64";
            os = "linux";
            compression = "gzip";
            hash1 {
                algo = "sha1";
            };
        };
    };
    configurations {
        default = "conf1";
        conf1 {
            description = "Boot Linux kernel with FDT blob + ramdisk";
            kernel = "kernel";
            fdt = "fdt-1", "fdt-2";
	    ramdisk = "ramdisk";
            hash1 {
                algo = "sha1";
            };
        };
    };
};
```

## zynqmp/fitImage-zynqmp-zcu104.its
```
/dts-v1/;

/ {
    description = "U-Boot fitImage for plnx_aarch64 kernel";
    #address-cells = <1>;

    images {
        kernel {
            description = "Linux Kernel";
            data = /incbin/("./../../linux-xlnx/arch/arm64/boot/Image");
            type = "kernel";
            arch = "arm64";
            os = "linux";
            compression = "none";
            load = <0x80000>;
            entry = <0x80000>;
            hash {
                algo = "sha1";
            };
        };
        fdt-1 {
            description = "Flattened Device Tree blob";
            data = /incbin/("../../u-boot-xlnx/arch/arm/dts/zynqmp-zcu104-revC.dtb");
            type = "flat_dt";
            arch = "arm64";
            load = <0x10000000>;
            compression = "none";
            hash {
                algo = "sha1";
            };
        };
        fdt-2 {
            description = "Flattened Device Tree overlay";
            data = /incbin/("zynqmp-optee.dtbo");
            type = "flat_dt";
            arch = "arm64";
            load = <0x11000000>;
            compression = "none";
            hash {
                algo = "sha1";
            };
        };
        ramdisk {
            description = "ramdisk";
            data = /incbin/("../../out-br/images/rootfs.cpio.gz");
            type = "ramdisk";
            arch = "arm64";
            os = "linux";
            compression = "gzip";
            hash {
                algo = "sha1";
            };
        };
    };
    configurations {
        default = "conf";
        conf {
            description = "Boot Linux kernel with FDT blob + ramdisk";
            kernel = "kernel";
            fdt = "fdt-1", "fdt-2";
	    ramdisk = "ramdisk";
            hash {
                algo = "sha1";
            };
        };
    };
};
```
